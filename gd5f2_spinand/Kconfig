## gd5f2_spinand/Kconfig
```kconfig
config MTD_SPINAND_GD5F2
	tristate "SPINAND Device Support for GigaDevice"
	depends on MTD_NAND && SPI
	default y
	help
	This enables support for access SPI NAND flash
	  devices.
	  If you have GagiDevice SPI NAND chip say yes.

	  If unsure, say no here.

config MTD_SPINAND_ONDIEECC
	bool "Use SPINAND internal ECC"
	depends on MTD_SPINAND_GD5F2
	help
	  Internal ECC.
	  Enables Hardware ECC support for SPI NAND.
```

## gd5f2g-driver/gd5f2xx_spinand/Kconfig
```kconfig
config MTD_SPINAND_GD5F2_XX
	tristate "SPINAND Device Support for GD5F2 whose chip size if 2G"
	default y
	depends on MTD_NAND && SPI
	help
	  This enables support for accessing gd5f2gd5xexx SPI NAND flash
	  devices.
	  If you have gd5f2xx SPI NAND chip say yes.

	  If unsure, say no here.

config MTD_SPINAND_ONDIEECC
	bool "Use SPINAND internal ECC"
	depends on MTD_SPINAND_GD5F2
	help
	  Internal ECC.
	  Enables Hardware ECC support for Winbone SPI NAND.
```

## gd5f2g-driver/kconfig.patch
```kconfig
diff --git a/kernel/linux-asic/drivers/staging/Kconfig b/kernel/linux-asic/drivers/staging/Kconfig
index 85f7590..ab71da3 100644
--- a/kernel/linux-asic/drivers/staging/Kconfig
+++ b/kernel/linux-asic/drivers/staging/Kconfig
@@ -107,4 +107,5 @@ source "drivers/staging/greybus/Kconfig"
 source "drivers/staging/vc04_services/Kconfig"
 
 source "drivers/staging/w25n_spinand/Kconfig"
+source "drivers/staging/gd5f2xx_spinand/Kconfig"
 endif # STAGING
```
